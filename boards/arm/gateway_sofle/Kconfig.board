## boards/arm/gateway_sofle/Kconfig.board
```kconfig
#
# Copyright (c) 2024 The ZMK Contributors
# SPDX-License-Identifier: MIT
#

config BOARD_GATEWAY_SOFLE_LEFT
    bool "gateway_sofle left"
    depends on SOC_NRF52840_QIAA

config BOARD_GATEWAY_SOFLE_RIGHT
    bool "gateway_sofle right"
    depends on SOC_NRF52840_QIAA
```

## config/west.yml
```yaml
manifest:
  remotes:
    - name: zmkfirmware
      url-base: https://github.com/zmkfirmware
      # Additional modules containing boards/shields/custom code can be listed here as well.
      # See:
      # - https://zmk.dev/docs/features/modules
      # - https://docs.zephyrproject.org/3.5.0/develop/west/manifest.html#projects
  #  - name: gpeye
  #    url-base: https://github.com/GPeye
  projects:
    - name: gateway_sofle
      url: https://github.com/haram0909/eyelash-sofle-zmk
      revision: gateway #main
    - name: zmk
      remote: zmkfirmware
      revision: v0.3.0 #pin ZMK version
      import: app/west.yml
  self:
    path: boards
```
